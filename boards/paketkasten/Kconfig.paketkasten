## boards/paketkasten/Kconfig.paketkasten
```kconfig
# Copyright (c) 2025 Conny Marco Menebröcker
# SPDX-License-Identifier: Apache-2.0

config BOARD_PAKETKASTEN
	select SOC_STM32L100XB
```

## boards/paketkasten/board.yml
```yaml
board:
  name: paketkasten
  full_name: Paketkasten Schlosselektronik
  vendor: dhl
  socs:
    - name: stm32l100xb
```

## boards/paketkasten/paketkasten_defconfig
```kconfig
# Copyright (c) 2025 Conny Marco Menebröcker
# SPDX-License-Identifier: Apache-2.0

# Enable MPU
CONFIG_ARM_MPU=y

# Enable HW stack protection
CONFIG_HW_STACK_PROTECTION=y

# enable GPIO
CONFIG_GPIO=y

# enable USART
CONFIG_SERIAL=y
CONFIG_UART_STM32=y
CONFIG_UART_ASYNC_API=y
CONFIG_UART_INTERRUPT_DRIVEN=y

# enable console
CONFIG_CONSOLE=y
CONFIG_UART_CONSOLE=y

#enable PWM
CONFIG_PWM=y

#enable ADC
CONFIG_ADC=y
CONFIG_ADC_STM32=y
CONFIG_ADC_ASYNC=y
CONFIG_ADC_STM32_DMA=y
CONFIG_DMA=y

#Power Mangement
#CONFIG_PM=y
#CONFIG_PM_DEVICE=y

#RFID
CONFIG_RFID=y
CONFIG_RFID_CR95HF=y
CONFIG_SPI=y
CONFIG_SPI_STM32=y
CONFIG_SPI_STM32_DMA=y
CONFIG_RFID_ISO14443=y
CONFIG_RFID_ISO14443A=y
CONFIG_CRC=y

#EEPROM
CONFIG_EEPROM=y
CONFIG_EEPROM_AT25=y
```
